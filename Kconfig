## Kconfig
```kconfig
# This file is part of vermillion.

# Vermillion is free software: you can redistribute it and/or modify it
# under the terms of the GNU General Public License as published
# by the Free Software Foundation, version 3.

# Vermillion is distributed in the hope that it will be useful,
# but WITHOUT ANY WARRANTY; without even the implied warranty of
# MERCHANTABILITY or FITNESS FOR A PARTICULAR PURPOSE.
# See the GNU General Public License for more details.

# You should have received a copy of the GNU General Public License
# along with vermillion. If not, see <https://www.gnu.org/licenses/>.

# Architecture configuration

menu "General setup"

choice ARCH
    prompt "Architecture"
config ARCH_ARM
    bool "ARM"
endchoice

menu "Architecture options"
source arch/arm/Kconfig
endmenu

menu "Compilation"
config ARCH
    string "Arch name"
    default arm  if ARCH_ARM
config TARGET
    string "Target triple"
    default arm-none-eabi if ARCH_ARM
config CFLAGS_ARCH
    string "Additional Arch CFLAGS"
    default "-fpic -Wl,--no-warn-rwx-segment" if ARCH_ARM
config CFLAGS_BOARD
    string "Additional Board CFLAGS"
config DEVICE_TREE
    string "Board device tree"
endmenu

menu "General purpose RAM"
config RAM_ADDRESS
    hex "Mapped address"
config RAM_SIZE
    hex "Full length"
config STACK_SIZE
    hex "Kernel stack size"
    default 0x8000
endmenu

endmenu

# Driver configuration

menu "Device drivers"

# Storage configuration

menu "Storage"
config STORAGE_MEMORY
    bool "Memory device"
config STORAGE_SUNXI_MMC
    bool "Sunxi SD/MMC"
    default y if ARCH_ARM_SUNXI
    depends on ARCH_ARM
endmenu

# Filesystem configuration

menu "Filesystem"
config FS_MBR
    bool "MBR"
config FS_FAT32
    bool "Fat32"
endmenu

# Serial configuration

menu "Serial"
config SERIAL_SUNXI_UART
    bool "Sunxi UART"
    default y if ARCH_ARM_SUNXI
    depends on ARCH_ARM
endmenu

# SPI configuration

menu "SPI"
config SPI_SUNXI_SPI
    bool "Sunxi SPI"
    default y if ARCH_ARM_SUNXI
    depends on ARCH_ARM
endmenu

# Timer configuration

menu "Timer"
config TIMER_SUNXI_TIMER
    bool "Sunxi Timer"
    default y if ARCH_ARM_SUNXI
    depends on ARCH_ARM
endmenu

# GPIO configuration

menu "GPIO"
config GPIO_SUNXI_GPIO
    bool "Sunxi GPIO"
    default y if ARCH_ARM_SUNXI
    depends on ARCH_ARM
endmenu

endmenu
```

## arch/arm/Kconfig
```kconfig
# This file is part of vermillion.

# Vermillion is free software: you can redistribute it and/or modify it
# under the terms of the GNU General Public License as published
# by the Free Software Foundation, version 3.

# Vermillion is distributed in the hope that it will be useful,
# but WITHOUT ANY WARRANTY; without even the implied warranty of
# MERCHANTABILITY or FITNESS FOR A PARTICULAR PURPOSE.
# See the GNU General Public License for more details.

# You should have received a copy of the GNU General Public License
# along with vermillion. If not, see <https://www.gnu.org/licenses/>.

choice ARM_SUBARCH
    prompt "ARM architecture"
    depends on ARCH_ARM
config ARCH_ARM_GENERIC
    bool "Generic"
config ARCH_ARM_SUNXI
    bool "Sunxi"
endchoice

menu "Generic Interrupt Controller"
    depends on ARCH_ARM
config GIC_CPU
    hex "CPU address"
config GIC_DIST
    hex "DIST address"
choice GIC_TYPE
    prompt "Interrupt Type"
config GIC_TYPE_0
    bool "Low level"
config GIC_TYPE_1
    bool "High level"
config GIC_TYPE_2
    bool "Low edge"
config GIC_TYPE_3
    bool "High edge"
endchoice
endmenu

config DISK_SIZE
    int "Disk size"
    depends on ARCH_ARM
config UBOOT_CONFIG
    string "U-boot defconfig"
    depends on ARCH_ARM
config UBOOT_IMAGE
    string "U-boot image path"
    depends on ARCH_ARM
config QEMU_MACHINE
    string "QEMU machine"
    depends on ARCH_ARM
```

## config/i686_defconfig
```kconfig
# This file is part of vermillion.

# Vermillion is free software: you can redistribute it and/or modify it
# under the terms of the GNU General Public License as published
# by the Free Software Foundation, version 3.

# Vermillion is distributed in the hope that it will be useful,
# but WITHOUT ANY WARRANTY; without even the implied warranty of
# MERCHANTABILITY or FITNESS FOR A PARTICULAR PURPOSE.
# See the GNU General Public License for more details.

# You should have received a copy of the GNU General Public License
# along with vermillion. If not, see <https://www.gnu.org/licenses/>.

CONFIG_ARCH_I686=y

CONFIG_RAM_ADDRESS=0x100000
CONFIG_RAM_SIZE=0x20000000

CONFIG_SERIAL_I686=y
```

## config/orangepi_one_defconfig
```kconfig
# This file is part of vermillion.

# Vermillion is free software: you can redistribute it and/or modify it
# under the terms of the GNU General Public License as published
# by the Free Software Foundation, version 3.

# Vermillion is distributed in the hope that it will be useful,
# but WITHOUT ANY WARRANTY; without even the implied warranty of
# MERCHANTABILITY or FITNESS FOR A PARTICULAR PURPOSE.
# See the GNU General Public License for more details.

# You should have received a copy of the GNU General Public License
# along with vermillion. If not, see <https://www.gnu.org/licenses/>.

CONFIG_ARCH_ARM=y
CONFIG_ARCH_ARM_SUNXI=y
CONFIG_ARM_GIC=y

CONFIG_UBOOT_CONFIG="orangepi_one_defconfig"
CONFIG_UBOOT_IMAGE="u-boot-sunxi-with-spl.bin"
CONFIG_QEMU_MACHINE="orangepi-pc"

CONFIG_ARCH="arm"
CONFIG_TARGET="arm-none-eabi"
CONFIG_CFLAGS_ARCH="-fpic -Wl,--no-warn-rwx-segment"
CONFIG_CFLAGS_BOARD="-mcpu=cortex-a7 -mfloat-abi=soft"
CONFIG_DEVICE_TREE="devtree/sunxi_h3.c"
CONFIG_SUNXI_BOARD="ORANGEPI_ONE"

CONFIG_RAM_ADDRESS=0x40000000
CONFIG_RAM_SIZE=0x20000000
CONFIG_STACK_SIZE=0x8000

CONFIG_FS_MBR=y
CONFIG_FS_FAT32=y

CONFIG_STORAGE_SUNXI_MMC=y
CONFIG_SERIAL_SUNXI_UART=y
CONFIG_TIMER_SUNXI_TIMER=y
CONFIG_GPIO_SUNXI_GPIO=y
```

## core/Kconfig
```kconfig
# This file is part of vermillion.

# Vermillion is free software: you can redistribute it and/or modify it
# under the terms of the GNU General Public License as published
# by the Free Software Foundation, version 3.

# Vermillion is distributed in the hope that it will be useful,
# but WITHOUT ANY WARRANTY; without even the implied warranty of
# MERCHANTABILITY or FITNESS FOR A PARTICULAR PURPOSE.
# See the GNU General Public License for more details.

# You should have received a copy of the GNU General Public License
# along with vermillion. If not, see <https://www.gnu.org/licenses/>.

# Architecture configuration

menu "General setup"

choice ARCH
    prompt "Architecture"
config ARCH_ARM
    bool "ARM"
config ARCH_I686
    bool "i686"
endchoice

menu "Architecture options"
source arch/arm/Kconfig
source arch/i686/Kconfig
endmenu

menu "Compilation"
config ARCH
    string "Arch name"
    default arm  if ARCH_ARM
    default i686 if ARCH_I686
config TARGET
    string "Target triple"
    default arm-none-eabi if ARCH_ARM
    default i686-elf      if ARCH_I686
config CFLAGS_ARCH
    string "Additional Arch CFLAGS"
    default "-fpic -Wl,--no-warn-rwx-segment" if ARCH_ARM
config CFLAGS_BOARD
    string "Additional Board CFLAGS"
config DEVICE_TREE
    string "Board device tree"
endmenu

menu "General purpose RAM"
config RAM_ADDRESS
    hex "Mapped address"
    default 0x100000   if ARCH_I686
config RAM_SIZE
    hex "Full length"
config STACK_SIZE
    hex "Kernel stack size"
    default 0x8000
endmenu

endmenu

# Driver configuration

menu "Device drivers"

# Video configuration

menu "Video Output"
config VIDEO_ILI9488
    bool "Ili9488"
config VIDEO_VIRTUAL
    bool "Virtual Framebuffer"
endmenu

# Audio configuration

menu "Audio Output"
config AUDIO_BUZZER
    bool "Buzzer"
endmenu

# Storage configuration

menu "Storage"
config STORAGE_MEMORY
    bool "Memory device"
config STORAGE_SUNXI_MMC
    bool "Sunxi SD/MMC"
    default y if ARCH_ARM_SUNXI
    depends on ARCH_ARM
endmenu

# Filesystem configuration

menu "Filesystem"
config FS_FAT32_MBR
    bool "Fat32 MBR"
endmenu

# Serial configuration

menu "Serial"
config SERIAL_SUNXI_UART
    bool "Sunxi UART"
    default y if ARCH_ARM_SUNXI
    depends on ARCH_ARM
config SERIAL_I686
    bool "x86 serial ports"
    default y if ARCH_I686
    depends on ARCH_I686
endmenu

# Timer configuration

menu "Timer"
config TIMER_SUNXI_TIMER
    bool "Sunxi Timer"
    default y if ARCH_ARM_SUNXI
    depends on ARCH_ARM
config TIMER_I686_TIMER
    bool "8254 Intel Timer"
    default y if ARCH_I686
    depends on ARCH_I686
endmenu

# Protocols configuration

menu "Protocols"
config PROTOCOL_SPI
    bool "Software SPI"
config PROTOCOL_SIPO
    bool "Serial-in Parallel-out"
endmenu

# GPIO configuration

menu "GPIO"
config GPIO_SUNXI_GPIO
    bool "Sunxi GPIO"
    default y if ARCH_ARM_SUNXI
    depends on ARCH_ARM
endmenu

endmenu
```

## core/arch/arm/Kconfig
```kconfig
# This file is part of vermillion.

# Vermillion is free software: you can redistribute it and/or modify it
# under the terms of the GNU General Public License as published
# by the Free Software Foundation, version 3.

# Vermillion is distributed in the hope that it will be useful,
# but WITHOUT ANY WARRANTY; without even the implied warranty of
# MERCHANTABILITY or FITNESS FOR A PARTICULAR PURPOSE.
# See the GNU General Public License for more details.

# You should have received a copy of the GNU General Public License
# along with vermillion. If not, see <https://www.gnu.org/licenses/>.

choice ARM_SUBARCH
    prompt "ARM architecture"
    depends on ARCH_ARM
config ARCH_ARM_GENERIC
    bool "Generic"
config ARCH_ARM_SUNXI
    bool "Sunxi"
endchoice

config ARM_GIC
    bool "GIC driver"

config DISK_SIZE
    int "Disk size"
    depends on ARCH_ARM
config UBOOT_CONFIG
    string "U-boot defconfig"
    depends on ARCH_ARM
config UBOOT_IMAGE
    string "U-boot image path"
    depends on ARCH_ARM
config QEMU_MACHINE
    string "QEMU machine"
    depends on ARCH_ARM
```
